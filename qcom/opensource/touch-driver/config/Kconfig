## qcom/opensource/touch-driver/config/Kconfig
```kconfig
config TRUSTED_TOUCH
        tristate "Short description of export TRUSTED_TOUCH"
        help
          Long description of export TRUSTED_TOUCH
```

## qcom/opensource/touch-driver/q200/focaltech_3383/Kconfig
```kconfig
config CONFIG_TOUCHSCREEN_FOCALTECH_3383
	tristate "focaltech tianma spi touchscreen"
	default n
	help
	  Say Y here if you have a focaltech series touch controller
	  to your system.
	  If build module, say M.
	  If unsure, say N.
```
